AUTOSAR XML
4 x :
  ContainerB  # AA
  ContainerA  # BB
  ContainerC  # CC
  Container5  # kk
